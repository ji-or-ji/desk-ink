## software/components/app/Kconfig
```kconfig
menu "Desk-ink app"

    config APP_SKIP_INPUT
        bool "Skip five-way switch init (QEMU/emulation only)"
        default n
        help
            adc_oneshot_new_unit() 会做 ADC 自校准，QEMU 不模拟该外设，
            会死循环。仿真时打开本项跳过 input 初始化。

    config APP_SKIP_EINK
        bool "Skip e-ink panel init (QEMU/emulation only)"
        default n
        help
            QEMU 不模拟墨水屏 SPI，eink_init() 的 SPI 传输会卡住。
            仿真时打开本项跳过 eink 初始化（flush 变 no-op）。

    config APP_QEMU_DUMP_B64
        bool "Dump framebuffer as base64 (QEMU/emulation only)"
        default n
        help
            把 framebuffer（15000 字节）base64 打到串口，格式：
              FB64 BEGIN 15000 <label>
              <每行 200 字符>
              FB64 END
            主机端 tools/fb64-decode.ps1 可还原成精确 1-bit 图。

    config APP_QEMU_TOUR
        bool "Auto-render all UI states on boot (QEMU/emulation only)"
        default n
        select APP_QEMU_DUMP_B64
        help
            开机后依次渲染 IDLE/MENU/CONFIG/TODO/POMO/全屏插画等状态，
            每步 dump 一次 framebuffer。只驱动渲染路径，不走 input_poll。

endmenu
```

## software/components/demo/Kconfig
```kconfig
menu "Desk-ink Bad Apple demo"

    config DEMO_BADAPP_BUNDLE_PATH
        string "BAF1 bundle path on LittleFS"
        default "/littlefs/badapple.baf"
        depends on APP_DEMO_BADAPP
        help
            播放器从该路径读 BAF1 帧包。格式与生成方式见 tools/badapple/README.md。

    config DEMO_BADAPP_LOOPS
        int "Playback loops (0 = play once)"
        default 0
        range 0 1000
        depends on APP_DEMO_BADAPP

    config DEMO_MAX_FRAMES
        int "Max frames to play (0 = all)"
        default 0
        depends on APP_DEMO_BADAPP
        help
            只播前 N 帧，QEMU 快速验证用。

    config DEMO_EMBED_BUNDLE
        bool "Embed testdata/badapple.baf and copy to LittleFS at boot"
        default n
        depends on APP_DEMO_BADAPP
        help
            没有 PC 推流链路时，把 tools/badapple 生成的帧包编进固件，
            启动时写入 LittleFS，用于 QEMU 验证播放逻辑。

    config DEMO_DUMP_EVERY
        int "Dump every Nth frame as FB64 (0 = off)"
        default 0
        range 0 10000
        depends on APP_DEMO_BADAPP
        help
            每 N 帧把 framebuffer 以 base64 打到串口，格式与 app/qemu_tour.c 一致，
            主机 tools/fb64-decode.ps1 可还原成 PNG。

endmenu
```

## software/sdkconfig.defaults
```kconfig
# ESP32-C3 桌面墨水屏信息站 — 默认 sdkconfig
# target 必须写成带引号的字符串形式，cmake 才会识别（esp-idf/tools/cmake/targets.cmake）
CONFIG_IDF_TARGET="esp32c3"
CONFIG_ESPTOOLPY_FLASHSIZE_4MB=y
CONFIG_ESPTOOLPY_FLASHSIZE="4MB"

# 自定义分区表：app 1.5MB + littlefs ~2.4MB（见 partitions.csv / architecture.md）
CONFIG_PARTITION_TABLE_CUSTOM=y
CONFIG_PARTITION_TABLE_CUSTOM_FILENAME="partitions.csv"

# 日志走 USB Serial/JTAG；UART0（GPIO20/21）留给 VG6328A 蓝牙模块
CONFIG_ESP_CONSOLE_USB_SERIAL_JTAG=y
# CONFIG_ESP_CONSOLE_UART_DEFAULT is not set
CONFIG_ESP_CONSOLE_SECONDARY_NONE=y
```
